## RTK_main/components/cli/Kconfig
```kconfig
menu "RTK console (ADR-0007)"

    config RTK_CONSOLE_UART_NUM
        int "Console UART port number"
        default 0
        range 0 2

    config RTK_CONSOLE_UART_BAUD
        int "Console UART baud rate"
        default ESP_CONSOLE_UART_BAUDRATE
        range 9600 4000000
        help
            默认跟随 ESP_CONSOLE_UART_BAUDRATE（IDF 控制台波特率），避免两个配置不一致导致乱码。
            本工程 sdkconfig.defaults 把两者都设为 2000000；>1 MHz 时 UART 驱动改用 APB 时钟。

    config RTK_CONSOLE_UART_TX_BUF
        int "Console UART TX ring buffer size (bytes)"
        default 8192
        range 0 32768
        help
            经典 ESP32 没有 UHCI/UART DMA，长输出只能靠 TX 环形缓冲 + 中断搬运。
            0 = 保留 IDF 的同步阻塞发送（TX 缓冲为 0）；大于 0 时在 esp_console_new_repl_uart()
            之后重装带 TX 环形的驱动（ADR-0009 §2.4）。占用静态 DRAM，按需调整。

    config RTK_CONSOLE_CMDLINE_MAX
        int "Console max command line length (bytes)"
        default 256
        range 64 4096

    config RTK_CONSOLE_STACK_SIZE
        int "Console REPL task stack size (bytes)"
        default 4096
        range 2048 16384

    config RTK_CONSOLE_TASK_PRIO
        int "Console REPL task priority"
        default 2
        range 1 24

    config RTK_CONSOLE_TASK_CORE
        int "Console REPL task core affinity"
        default 0
        range 0 1

endmenu
```

## RTK_main/components/gnss/Kconfig
```kconfig
menu "GNSS drivers (ADR-0012)"

    config RTK_GNSS_DRV_UNICORE
        bool "Unicore N4 (UM980/UM981/UM982)"
        default y

    config RTK_GNSS_DRV_UBLOX
        bool "u-blox F9 (ZED-F9P), not hardware-verified"
        default y

    config RTK_GNSS_DRV_COMNAV
        bool "ComNav K8 (K803), experimental"
        default n
        help
            未取得官方命令手册，按 NovAtel 风格语法实现，未经实物验证。

endmenu
```

## RTK_main/components/rtk_bt/Kconfig
```kconfig
menu "RTK Bluetooth SPP (ADR-0006)"

    config RTK_BT_SPP_RX_BUF_SIZE
        int "Per-session RX stream buffer size (bytes)"
        range 1024 16384
        default 4096
        help
            Each SPP session owns one static receive StreamBuffer of this size. Bytes arriving while it is
            full are dropped and counted as rx_dropped. NTRIP corrections relayed by the phone arrive in
            bursts of several KB, so the default is 4096. Total static RAM = this value x RTK_BT_SPP_MAX_SESSIONS.

endmenu
```

## RTK_main/components/rtk_console/Kconfig
```kconfig
menu "RTK console (ADR-0007)"

    config RTK_CONSOLE_UART_NUM
        int "Console UART port number"
        default 0
        range 0 2

    config RTK_CONSOLE_UART_BAUD
        int "Console UART baud rate"
        default 115200
        range 9600 4000000

    config RTK_CONSOLE_CMDLINE_MAX
        int "Console max command line length (bytes)"
        default 256
        range 64 4096

    config RTK_CONSOLE_STACK_SIZE
        int "Console REPL task stack size (bytes)"
        default 4096
        range 2048 16384

    config RTK_CONSOLE_TASK_PRIO
        int "Console REPL task priority"
        default 2
        range 1 24

    config RTK_CONSOLE_TASK_CORE
        int "Console REPL task core affinity"
        default 0
        range 0 1

endmenu
```

## RTK_main/components/stream_demux/Kconfig
```kconfig
menu "Stream demux (ADR-0005)"

    config STREAM_DEMUX_RTCM3
        bool "RTCM3 decoder"
        default y

    config STREAM_DEMUX_NMEA
        bool "NMEA 0183 decoder"
        default y

    config STREAM_DEMUX_UBX
        bool "u-blox UBX decoder"
        default y

    config STREAM_DEMUX_UNICORE_BIN
        bool "Unicore binary (AA 44 B5) decoder"
        default y

    config STREAM_DEMUX_UNICORE_HASH
        bool "Unicore hash (#...*) sentence decoder"
        default y

endmenu
```

## RTK_main/main/Kconfig.projbuild
```kconfig
menu "RTK_main"

    choice RTK_BOARD
        prompt "Board profile"
        default RTK_BOARD_AUTO

        config RTK_BOARD_AUTO
            bool "Identify using GPIO35"

        config RTK_BOARD_FORCE_E1_DEVKIT
            bool "Force E1 DevKit (bench only)"

        config RTK_BOARD_FORCE_P2_V141
            bool "Force P2 v1.41 (bench only)"
    endchoice

    choice RTK_LINK_POLICY
        prompt "SPP link policy"
        default RTK_LINK_POLICY_CONCURRENT
        help
            选择手机与报警器同时在线（CONCURRENT）或手机优先（PHONE_PREEMPT）。
            PHONE_PREEMPT 下手机接入会断开报警器，手机在线时拒绝新的报警器。

        config RTK_LINK_POLICY_CONCURRENT
            bool "CONCURRENT: phone and alarm online together"

        config RTK_LINK_POLICY_PHONE_PREEMPT
            bool "PHONE_PREEMPT: phone disconnects alarm"
    endchoice

    config RTK_LINK_RX_BUF_BYTES
        int "kLink per-session RX staging buffer size (bytes)"
        range 256 1024
        default 512
        help
            kLink 每会话从 spp_server 一次拉取并跨轮保留未消费尾字节的暂存缓冲大小。
            默认 512 B；可回退到 256 B 以观察对吞吐的影响。

    config RTK_TRACE_ENABLE
        bool "Enable runtime debug trace (trace ring, debug module and commands)"
        default y
        help
            ADR-0009 运行时追踪。关闭后：fw::trace()/trace_on() 编译为空内联（各组件调用点被优化掉），
            spp_server 不再调用追踪钩子，main 不编译 debug 模块（追踪环、trace_out 任务、debug 命令组、
            NVS "dbg" 键表）。调试阶段保持开启。

    config RTK_LOG_LEVEL
        int "Compile-time max component log level (0=E 1=W 2=I 3=D, ADR-0009 §2.12)"
        range 0 3
        default 3
        help
            fw/Log.hpp 的 FW_LOGE/W/I/D 编译期上限：高于它的调用连同参数求值一起编译掉。
            运行期 E/W 总是输出；I/D 还需 `debug on <类别>` 且不高于 `debug level`。
            关闭 RTK_TRACE_ENABLE 时 I/D 无法打开，上限自动按 W 处理。

    config RTK_LOG_RING_BYTES
        int "Text log ring size (bytes, ADR-0009 §2.11)"
        depends on RTK_TRACE_ENABLE
        range 1024 16384
        default 4096
        help
            fw::LogRing 的字节容量：变长记录环，容纳 fw::tlog()/tlog_hex() 写出的句子与原始字节。
            整条记录放不下就丢弃并计数（不做拆段），因此容量至少要能装下最长的一条
            （12 B 记录头 + 256 B 十六进制载荷）。fw/Log.hpp 的 FW_LOG* 也写入此环。静态存储，不占堆。

    config RTK_BOOT_VERBOSE
        bool "Print the boot step table after boot (R8a)"
        default n
        help
            启动成功后除了单行摘要，再打印 `sys boot` 的同一张步骤表（步骤、结果、耗时、堆水位、
            降级原因）。仅影响输出，不影响启动顺序或内存布局。

    config RTK_BOOT_FAULT_STEP
        string "Force a boot step to fail (HIL only, R8a)"
        default ""
        help
            仅用于台架验证启动降级路径：填步骤名（identify/power/banner/earlyConfig/radio/contexts/console/alloc/bind/seal/
            debug/storage/system/link/io/started）时该步不执行并返回失败，原因记为 ``fault:<step>``。
            留空即正常启动。不得在产品固件中填写。

    config RTK_STRICT_WARNINGS
        bool "Treat all warnings in project code as errors (debug phase)"
        default y
        help
            调试阶段默认开启：本工程组件、main 与 test_apps 的所有编译告警都按错误处理，
            包括 IDF 默认降级为告警的 unused-*/deprecated-declarations/extra，
            以及 IDF 默认关闭的 unused-parameter、sign-compare（见 cmake/strict_warnings.cmake）。
            只影响本工程代码，不影响 IDF 自身组件。

    choice RTK_CONSOLE_PROFILE
        prompt "Console build profile"
        default RTK_CONSOLE_PROFILE_DEV
        help
            ADR-0016 控制台构建档位，在编译时选择。
            DEV 保留完整开发控制台（默认）。
            PRODUCTION 保留诊断、隐藏的 factory 工厂配置和 freset。
            NONE 只保留串口日志，不启动 REPL。

        config RTK_CONSOLE_PROFILE_DEV
            bool "DEV: development console"

        config RTK_CONSOLE_PROFILE_PRODUCTION
            bool "PRODUCTION: diagnostics and factory console"

        config RTK_CONSOLE_PROFILE_NONE
            bool "NONE: UART logging only"
    endchoice

    config RTK_FACTORY_KEY
        string "Factory console unlock key"
        default "rtk-factory"
        help
            Key for the hidden `factory unlock <key>` console command (ADR-0009 §2.10).
            Factory commands write production settings (SN, alarm whitelist) or force
            alarm state; keep the key out of customer documentation.

    config RTK_WIFI_CONFIG_ENABLE
        bool "Enable Wi-Fi configuration radio mode (ADR-0017)"
        default y
        help
            Allow selecting Wi-Fi configuration mode at the next software restart.
            Disable to boot in Bluetooth mode and omit the radio console command.

    menu "GNSS (ADR-0010)"

        config RTK_GNSS_ENABLE
            bool "Enable GNSS module (UART, probe/config, RTCM input pipe)"
            default y
            help
                关闭则不编译 gnss 模块、kIo 执行器与 RTCM 输入管道；rtcm 模块只做统计。

        config RTK_GNSS_UART_NUM
            int "UART port connected to GNSS module"
            depends on RTK_GNSS_ENABLE
            range 1 2
            default 2

        config RTK_GNSS_DEFAULT_BAUD
            int "Default module baud rate (first probe, no NVS record)"
            depends on RTK_GNSS_ENABLE
            range 9600 921600
            default 115200

        config RTK_GNSS_TARGET_BAUD
            int "Target runtime module baud rate after probe (no user NVS override)"
            depends on RTK_GNSS_ENABLE
            range 9600 921600
            default 460800
            help
                探测成功后的默认运行波特率（仅修改运行态，不发送 SAVECONFIG）。
                须取 validUserBaud 支持的标准速率（9600/19200/38400/57600/115200/230400/460800/921600）；
                用户经 gnss baud <n> 写入 NVS gnss/baud（非 0）时优先使用用户值。

        config RTK_GNSS_PORT
            int "E1 bench receiver port wired to ESP32 (UM980 COM2 = 2)"
            depends on RTK_GNSS_ENABLE
            range 1 3
            default 2

        config RTK_GNSS_RATE_HZ
            int "Default fix rate in Hz (1/2/5/10/20)"
            depends on RTK_GNSS_ENABLE
            range 1 20
            default 1

        config RTK_GNSS_APP_RING_BYTES
            int "GNSS App typed ring size (bytes, ADR-0011)"
            depends on RTK_GNSS_ENABLE
            range 1024 16384
            default 4096
            help
                fw::FanoutRing（typed 模式）静态环形缓冲大小；记录头 3 B，最大单条载荷为容量减 3 B。

        config RTK_GNSS_STATIC_OBS_ENABLE
            bool "Reserve static GNSS observation path (K6 placeholder)"
            depends on RTK_GNSS_ENABLE
            default n
            help
                K4 仅作配置占位（固定关闭），不分配 obs 观测环，不创建 SD/SPI/文件任务。

    endmenu

endmenu
```

## RTK_main/reference/c-v1/main/Kconfig.projbuild
```kconfig
menu "RTK_main"

    choice RTK_LINK_POLICY
        prompt "SPP link policy"
        default RTK_LINK_POLICY_CONCURRENT
        help
            选择手机与报警器同时在线（CONCURRENT）或手机优先（PHONE_PREEMPT）。
            PHONE_PREEMPT 下手机接入会断开报警器，手机在线时拒绝新的报警器。

        config RTK_LINK_POLICY_CONCURRENT
            bool "CONCURRENT: phone and alarm online together"

        config RTK_LINK_POLICY_PHONE_PREEMPT
            bool "PHONE_PREEMPT: phone disconnects alarm"
    endchoice

endmenu
```

## RTK_main/test_apps/rtk_pure/sdkconfig.defaults
```kconfig
# 纯逻辑测试与产品保持相同的 C++ 运行时约束。
CONFIG_COMPILER_CXX_EXCEPTIONS=n
CONFIG_COMPILER_CXX_RTTI=n
```

## RTK_main/test_apps/rtk_spp_peer/sdkconfig.defaults
```kconfig
CONFIG_IDF_TARGET="esp32"
CONFIG_ESPTOOLPY_FLASHSIZE_8MB=y
CONFIG_BT_ENABLED=y
CONFIG_BT_BLUEDROID_ENABLED=y
CONFIG_BT_CLASSIC_ENABLED=y
CONFIG_BT_SPP_ENABLED=y
CONFIG_BTDM_CTRL_MODE_BR_EDR_ONLY=y
CONFIG_BT_BLE_ENABLED=n
CONFIG_FREERTOS_HZ=1000
CONFIG_FREERTOS_SUPPORT_STATIC_ALLOCATION=y
CONFIG_ESP_MAIN_TASK_STACK_SIZE=6144
```
